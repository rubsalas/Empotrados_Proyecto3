## conf/bblayers.conf
```bitbake
# POKY_BBLAYERS_CONF_VERSION is increased each time build/conf/bblayers.conf
# changes incompatibly
POKY_BBLAYERS_CONF_VERSION = "2"

BBPATH = "${TOPDIR}"
BBFILES ?= ""

BBLAYERS ?= " \
  /home/jsantamaria/Documents/poky-dunfell-23.0.31/meta \
  /home/jsantamaria/Documents/poky-dunfell-23.0.31/meta-poky \
  /home/jsantamaria/Documents/poky-dunfell-23.0.31/meta-yocto-bsp \
  /home/jsantamaria/Documents/poky-dunfell-23.0.31/meta-raspberrypi \
  /home/jsantamaria/Documents/poky-dunfell-23.0.31/meta-atmel-dunfell \
  /home/jsantamaria/Documents/poky-dunfell-23.0.31/meta-oe \
  /home/jsantamaria/Documents/poky-dunfell-23.0.31/meta-clang-dunfell\
  "
```
